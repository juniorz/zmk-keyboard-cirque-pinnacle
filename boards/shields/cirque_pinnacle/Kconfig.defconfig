## boards/shields/cirque_pinnacle/Kconfig.defconfig
```kconfig
if SHIELD_CIRQUE_PINNACLE_CENTRAL || SHIELD_CIRQUE_PINNACLE_TRACKPAD

config ZMK_POINTING
    default y

endif
```

## boards/shields/cirque_pinnacle/Kconfig.shield
```kconfig
config SHIELD_CIRQUE_PINNACLE_CENTRAL
    def_bool $(shields_list_contains,cirque_pinnacle_central)
    depends on ZMK_SPLIT_ROLE_CENTRAL

config SHIELD_CIRQUE_PINNACLE_TRACKPAD
    def_bool $(shields_list_contains,cirque_pinnacle_trackpad)
```

## boards/shields/cirque_pinnacle_adapter/Kconfig.shield
```kconfig
config CIRQUE_PINNACLE_ADAPTER
    def_bool $(shields_list_contains,cirque_pinnacle_adapter)
```

## boards/shields/corne_pinnacle/Kconfig.defconfig
```kconfig
if SHIELD_CORNE_PINNACLE_CENTRAL || SHIELD_CORNE_PINNACLE_TRACKPAD

config ZMK_POINTING
    default y

endif

if SHIELD_CORNE_PINNACLE_TRACKPAD

config I2C
    default y

endif
```

## boards/shields/corne_pinnacle/Kconfig.shield
```kconfig
config SHIELD_CORNE_PINNACLE_CENTRAL
    def_bool $(shields_list_contains,corne_pinnacle_central)
    depends on ZMK_SPLIT_ROLE_CENTRAL
    # `select` maybe?

config SHIELD_CORNE_PINNACLE_TRACKPAD
    def_bool $(shields_list_contains,corne_pinnacle_trackpad)
    depends on SPI || I2C
```

## west.yml
```yaml
manifest:
  remotes:
    - name: petejohanson
      url-base: https://github.com/petejohanson
  projects:
    - name: cirque-input-module
      remote: petejohanson
      revision: main
```
