#include "cirque_pinnacle.dtsi"

/* cirque trackpad I2C pins */
/* See: https://zmk.dev/docs/development/hardware-integration/pointing?part-type=peripheral#input-device */

&gpio0 {
    status = "okay";
};

&cirque_pinnacle_i2c {
    status = "okay";

    glidepoint: glidepoint@2a {
        compatible = "cirque,pinnacle";
        status = "okay";
        reg = <0x2a>;
        dr-gpios = <&gpio0 6 GPIO_ACTIVE_HIGH>;     // D1 pin (nice!view compatible)

        sleep;
    };
};

// Overrides for the input-split child node
&glidepoint_split {
    device = <&glidepoint>;
};
