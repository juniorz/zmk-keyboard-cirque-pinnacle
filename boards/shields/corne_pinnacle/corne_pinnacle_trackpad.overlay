#include "corne_pinnacle.dtsi"

/* cirque trackpad I2C pins */
/* See: https://zmk.dev/docs/development/hardware-integration/pointing?part-type=peripheral#input-device */

&i2c0 {
    status = "disabled";
    glidepoint0: glidepoint@2a {
        compatible = "cirque,pinnacle";
        reg = <0x2a>;                                    // default slave address
        status = "disabled";
        dr-gpios = <&pro_micro 1 GPIO_ACTIVE_HIGH>;      // D1 pin

        sensitivity = "2x";
        sleep;

        // see: https://github.com/petejohanson/cirque-input-module/blob/main/dts/bindings/input/cirque%2Cpinnacle-common.yaml
        //rotate-90 = false;
        //x-invert = false;
        //y-invert = false;
        //sleep = false;
        //no-secondary-tap = false;
        //no-taps = false;
        //sensitivity = 1x | 2x | 3x | 4x
        //x-axis-z-min = 5;
        //y-axis-z-min= 4;
    };
};


// Overrides for the input-split child node
&glidepoint_split {
    device = <&glidepoint0>;
};